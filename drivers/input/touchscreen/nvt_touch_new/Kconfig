## drivers/input/touchscreen/nvt_touch_new/Kconfig
```kconfig
# SPDX-License-Identifier: GPL-2.0-only
#
# Novatek NT36xxx touchscreen driver configuration
#
config TOUCHSCREEN_NVT_NEW
	bool "Novatek NT36xxx"
	help
	  Say Y here if you have a Novatek NT36xxx touchscreen connected
	  to your system.

	  If unsure, say N.
```
